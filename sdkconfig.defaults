## sdkconfig.defaults
```kconfig
CONFIG_ESP_WIFI_STA_START=true
CONFIG_ESP_WIFI_SOFTAP_SUPPORT=y
CONFIG_ESP_WIFI_STA_RSSI_DISCONNECT_THRESHOLD=-90

CONFIG_LOG_DEFAULT_LEVEL_INFO=y
CONFIG_LOG_DEFAULT_LEVEL_DEBUG=n

CONFIG_MQTT_TRANSPORT_SSL=y
CONFIG_MQTT_TRANSPORT_WEBSOCKET=n

CONFIG_BOOTLOADER_LOG_LEVEL_INFO=y

CONFIG_ESP32_PANIC_PRINT_REBOOT=y

CONFIG_ESP_HTTP_CLIENT_ENABLE_HTTPS=y

CONFIG_FREERTOS_UNICORE=n
```
